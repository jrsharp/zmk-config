## config/west.yml
```yaml
manifest:
  remotes:
    - name: jrsharp
      url-base: https://github.com/jrsharp
  projects:
    - name: zmk
      remote: jrsharp
      revision: frst-w-pointers
      import: app/west.yml
  self:
    path: config
```
